## boards/arm/phyfob/Kconfig.board
```kconfig
# Copyright (c) 2021 Nordic Semiconductor ASA
# SPDX-License-Identifier: Apache-2.0

config BOARD_PHYFOB
	bool "phyfob"

	depends on SOC_NRF52832_QFAA
```

## boards/arm/phyfob/Kconfig.defconfig
```kconfig
# Copyright (c) 2021 Nordic Semiconductor ASA
# SPDX-License-Identifier: Apache-2.0

if BOARD_PHYFOB

if USB

config USB_NRFX
	default n

config USB_DEVICE_STACK
	default n

endif # USB

endif
```

## boards/arm/phyfob/board.yml
```yaml
board:
  name: phyfob
  full_name: phyfob
  vendor: phyphox
  socs:
  - name: nrf52832
```
