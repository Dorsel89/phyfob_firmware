## boards/arm/phyphox-keyfob/Kconfig.board
```kconfig
# Copyright (c) 2021 Nordic Semiconductor ASA
# SPDX-License-Identifier: Apache-2.0

config BOARD_PHYPHOX_KEYFOB
	bool "phyphox-keyfob"

	depends on SOC_NRF52832_QFAB
```

## boards/arm/phyphox-newton/Kconfig.board
```kconfig
# Copyright (c) 2021 Nordic Semiconductor ASA
# SPDX-License-Identifier: Apache-2.0

config BOARD_PHYPHOX_NEWTON
	bool "phyphox-newton"

	depends on SOC_NRF52833_QIAA
```

## boards/arm/phyphox-ruler/Kconfig.board
```kconfig
# Copyright (c) 2021 Nordic Semiconductor ASA
# SPDX-License-Identifier: Apache-2.0

config BOARD_PHYPHOX_RULER
	bool "phyphox-ruler"
	depends on SOC_NRF52833_QIAA
```

## boards/arm/phyphox_satellite/Kconfig.defconfig
```kconfig
# Copyright (c) 2021 Nordic Semiconductor ASA
# SPDX-License-Identifier: Apache-2.0

if BOARD_PHYPHOX_SATELLITE

config BOARD
	default "phyphox_satellite"

if USB

config USB_NRFX
	default y

config USB_DEVICE_STACK
	default y

endif # USB

config BT_CTLR
	default BT

endif
```
